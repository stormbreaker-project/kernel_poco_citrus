## drivers/input/touchscreen/NT36672A/Kconfig
```kconfig
#
# Novatek NT36xxx touchscreen driver configuration
#
config TOUCHSCREEN_NT36672A
	bool "Novatek NT36xxx host download SPI driver"
	default y
	help
	  Say Y here if you have a Novatek NT36xxx no flash touchscreen connected
	  to your system by SPI bus.

	  If unsure, say N.

config NT_VENDOR_TRULY
	bool "Load novatek truly firmware"
	depends on !MACH_POCO_CITRUS
	default y if MACH_XIAOMI_LIME
	help
	  Say Y here if your touchscreen is of truly vendor

config NT_VENDOR_TIANMA
	bool "Load novatek tianma firmware"
	depends on !MACH_XIAOMI_LIME
	default y if MACH_POCO_CITRUS
	help
	  Say Y here if your touchscreen is of tianma vendor
```

## drivers/lastkmsg/Kconfig
```kconfig
menuconfig LAST_KMSG
	tristate "Last Kmsg support"
	default y
	help
	  Exports last_kmsg
```

## drivers/platform/poco/Kconfig
```kconfig
# Poco configuration options

config MACH_POCO
	bool "Poco device"
	depends on ARCH_QCOM
	help
	  Support for Xiaomi products

config MACH_POCO_SM6115
        bool "POCO SM6115"
        depends on ARCH_QCOM
        select MACH_POCO
        help
          Support for Xiaomi SM6115 devices

menu "Poco board selection"

	config MACH_POCO_CITRUS
                bool "Poco citrus board"
                select MACH_POCO_SM6115
                help
                  Support for POCO M3

endmenu
```
